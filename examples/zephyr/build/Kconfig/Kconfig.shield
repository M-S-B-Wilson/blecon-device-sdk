## examples/zephyr/build/Kconfig/Kconfig.shield
```kconfig
osource "c:/users/marks/blecon-device-sdk/examples/zephyr/boards/shields/*/Kconfig.shield"
osource "C:/Users/marks/nrf/boards/shields/*/Kconfig.shield"
```

## examples/zephyr/build/Kconfig/Kconfig.shield.defconfig
```kconfig
osource "c:/users/marks/blecon-device-sdk/examples/zephyr/boards/shields/*/Kconfig.defconfig"
osource "C:/Users/marks/nrf/boards/shields/*/Kconfig.defconfig"
```

## examples/zephyr/build/Kconfig/Kconfig.sysbuild.modules
```kconfig
menu "nrf (C:/Users/marks/nrf)"
osource "C:/Users/marks/nrf/sysbuild/Kconfig.sysbuild"
config ZEPHYR_NRF_MODULE
	bool
	default y
endmenu
```
